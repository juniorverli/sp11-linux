// SPDX-License-Identifier: BSD-3-Clause
/*
 * Surface Pro 11: opt-in sound card with the digital microphones only.
 *
 * The board DTS disables the sound card and the WSA SoundWire controller
 * because the WSA8845 speaker amplifiers must not run without speaker
 * protection. This fragment re-enables the card for capture and keeps the
 * speaker path out of it:
 *
 *  - the WSA playback link and its routes are removed from the card;
 *  - &swr0 is not touched, so it stays as the board DTS left it (disabled),
 *    no WSA8845 is enumerated and the amplifiers are never programmed.
 *
 * The DisplayPort audio links of x1-microsoft-denali-audio-dp.dtsi are part of
 * the card in this variant: they add no speaker path.
 *
 * Include this file only from a DTS whose name says it is an audio variant.
 */
#include "x1-microsoft-denali-audio-dp.dtsi"

&{/sound} {
	status = "okay";

	audio-routing = "VA DMIC0", "vdd-micb",
			"VA DMIC1", "vdd-micb";

	/delete-node/ wsa-dai-link;
};
