## Documentation/devicetree/bindings/input/hid-over-spi.yaml
```yaml
# SPDX-License-Identifier: (GPL-2.0-only OR BSD-2-Clause)
%YAML 1.2
---
$id: http://devicetree.org/schemas/input/hid-over-spi.yaml#
$schema: http://devicetree.org/meta-schemas/core.yaml#

title: HID over SPI Devices

maintainers:
  - Benjamin Tissoires <bentiss@kernel.org>
  - Jiri Kosina <jikos@kernel.org>
  - Jingyuan Liang <jingyliang@chromium.org>

description: |+
  HID over SPI provides support for various Human Interface Devices over the
  SPI bus. These devices can be for example touchpads, keyboards, touch screens
  or sensors.

  The specification has been written by Microsoft and is currently available
  here: https://www.microsoft.com/en-us/download/details.aspx?id=103325

allOf:
  - $ref: /schemas/input/touchscreen/touchscreen.yaml#
  - $ref: /schemas/spi/spi-peripheral-props.yaml#

properties:
  compatible:
    enum:
      - microsoft,g6-touch-digitizer

  reg:
    maxItems: 1

  interrupts:
    maxItems: 1

  reset-gpios:
    maxItems: 1
    description:
      GPIO specifier for the device's reset line. The HID over SPI
      specification requires a dedicated, host-driven, active-low reset
      line. The line must be flagged with GPIO_ACTIVE_LOW.

  vdd-supply:
    description:
      Regulator for the VDD supply voltage.

required:
  - compatible
  - reg
  - interrupts
  - reset-gpios
  - vdd-supply

unevaluatedProperties: false

examples:
  - |
    #include <dt-bindings/interrupt-controller/irq.h>
    #include <dt-bindings/gpio/gpio.h>

    spi {
      #address-cells = <1>;
      #size-cells = <0>;

      hid@0 {
        compatible = "microsoft,g6-touch-digitizer";
        reg = <0x0>;
        interrupts-extended = <&gpio 42 IRQ_TYPE_EDGE_FALLING>;
        reset-gpios = <&gpio 27 GPIO_ACTIVE_LOW>;
        vdd-supply = <&pm8350c_l3>;
        pinctrl-names = "default";
        pinctrl-0 = <&ts_d6_int_bias>;
      };
    };
```

## Documentation/devicetree/bindings/media/i2c/ovti,ov13858.yaml
```yaml
# SPDX-License-Identifier: (GPL-2.0-only OR BSD-2-Clause)
%YAML 1.2
---
$id: http://devicetree.org/schemas/media/i2c/ovti,ov13858.yaml#
$schema: http://devicetree.org/meta-schemas/core.yaml#

title: OmniVision OV13858 CMOS image sensor

maintainers:
  - Sakari Ailus <sakari.ailus@linux.intel.com>

description:
  The OV13858 outputs RAW10 Bayer data on a four-lane CSI-2 D-PHY link
  and uses a 19.2 MHz input clock. Image processing is external. The common
  properties of video-interface-devices.yaml apply, including the leds and
  led-names = "privacy" pair that selects a privacy LED.

allOf:
  - $ref: /schemas/media/video-interface-devices.yaml#

properties:
  compatible:
    const: ovti,ov13858

  reg:
    maxItems: 1

  clocks:
    maxItems: 1

  dovdd-supply:
    description: I/O supply.

  dvdd-supply:
    description: Digital core supply.

  avdd-supply:
    description: Analog supply.

  reset-gpios:
    description: Active low sensor reset.
    maxItems: 1

  firmware-name:
    maxItems: 1
    description:
      Name of an optional register blob that adds sensor modes to the built-in
      ones, loaded with request_firmware(). The blob format is documented in
      drivers/media/i2c/sensor-regblob.h. The driver works with its built-in
      modes when the property or the file is missing.

  port:
    $ref: /schemas/graph.yaml#/$defs/port-base
    unevaluatedProperties: false
    properties:
      endpoint:
        $ref: /schemas/media/video-interfaces.yaml#
        unevaluatedProperties: false
        properties:
          bus-type:
            const: 4
          data-lanes:
            minItems: 4
            maxItems: 4
          link-frequencies:
            description:
              The 270 MHz and 540 MHz of the built-in modes, plus the link
              frequency of the modes in the register blob, if any.
            minItems: 2
            maxItems: 3
        required:
          - data-lanes
          - link-frequencies
    required:
      - endpoint

required:
  - compatible
  - reg
  - clocks
  - dovdd-supply
  - dvdd-supply
  - avdd-supply
  - port

unevaluatedProperties: false

examples:
  - |
    #include <dt-bindings/clock/qcom,x1e80100-camcc.h>
    #include <dt-bindings/gpio/gpio.h>

    i2c {
        #address-cells = <1>;
        #size-cells = <0>;

        camera@10 {
            compatible = "ovti,ov13858";
            reg = <0x10>;

            clocks = <&camcc CAM_CC_MCLK1_CLK>;

            reset-gpios = <&tlmm 110 GPIO_ACTIVE_LOW>;

            dovdd-supply = <&vreg_l6m_1p8>;
            dvdd-supply = <&vreg_l1m_1p2>;
            avdd-supply = <&vreg_l5m_2p8>;

            leds = <&camera_indicator>;
            led-names = "privacy";

            port {
                endpoint {
                    bus-type = <4>;
                    data-lanes = <1 2 3 4>;
                    link-frequencies = /bits/ 64 <270000000 540000000>;
                    remote-endpoint = <&camss_csiphy1_ep>;
                };
            };
        };
    };
```

## Documentation/devicetree/bindings/media/i2c/sony,imx681.yaml
```yaml
# SPDX-License-Identifier: (GPL-2.0-only OR BSD-2-Clause)
%YAML 1.2
---
$id: http://devicetree.org/schemas/media/i2c/sony,imx681.yaml#
$schema: http://devicetree.org/meta-schemas/core.yaml#

title: Sony IMX681 CMOS image sensor

maintainers:
  - juniorverli <25966843+juniorverli@users.noreply.github.com>

description:
  The Sony IMX681 is a RAW Bayer image sensor with a MIPI CSI-2 C-PHY output.
  It has no public register documentation, so the driver does not contain any
  sensor register value. The init, stream on, stream off and per-mode register
  sequences, the identification register, the exposure, gain and frame length
  registers and the media bus code (the Bayer order) are read from a register
  blob, named by firmware-name, that is generated locally. The blob format is
  documented in drivers/media/i2c/sensor-regblob.h.

allOf:
  - $ref: /schemas/media/video-interface-devices.yaml#

properties:
  compatible:
    const: sony,imx681

  reg:
    maxItems: 1

  clocks:
    description: Input clock, 19.2 MHz.
    maxItems: 1

  avdd-supply:
    description: Analog supply.

  dovdd-supply:
    description: Interface and digital I/O supply.

  reset-gpios:
    description: Active low sensor reset.
    maxItems: 1

  firmware-name:
    maxItems: 1
    description:
      Name of the register blob, loaded with request_firmware().

  port:
    $ref: /schemas/graph.yaml#/$defs/port-base
    unevaluatedProperties: false
    properties:
      endpoint:
        $ref: /schemas/media/video-interfaces.yaml#
        unevaluatedProperties: false
        properties:
          bus-type:
            const: 1
          data-lanes:
            description: Trios of the C-PHY link.
            minItems: 1
            maxItems: 3
          link-frequencies:
            description:
              Link frequencies of the modes in the register blob. For a C-PHY
              link this is half the symbol rate.
            minItems: 1
            maxItems: 8
        required:
          - bus-type
          - data-lanes
          - link-frequencies
    required:
      - endpoint

required:
  - compatible
  - reg
  - clocks
  - avdd-supply
  - dovdd-supply
  - firmware-name
  - port

unevaluatedProperties: false

examples:
  - |
    #include <dt-bindings/clock/qcom,x1e80100-camcc.h>
    #include <dt-bindings/gpio/gpio.h>

    i2c {
        #address-cells = <1>;
        #size-cells = <0>;

        camera@10 {
            compatible = "sony,imx681";
            reg = <0x10>;

            clocks = <&camcc CAM_CC_MCLK4_CLK>;

            reset-gpios = <&tlmm 237 GPIO_ACTIVE_LOW>;

            avdd-supply = <&vreg_l7b_2p8>;
            dovdd-supply = <&vreg_l3m_1p8>;

            firmware-name = "imx681-mshw0490.bin";

            leds = <&camera_indicator>;
            led-names = "privacy";

            port {
                endpoint {
                    bus-type = <1>;
                    data-lanes = <1>;
                    link-frequencies = /bits/ 64 <1200000000>;
                    remote-endpoint = <&camss_csiphy2_ep>;
                };
            };
        };
    };
```
